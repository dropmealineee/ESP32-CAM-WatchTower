/*
 * +==========================================================================+
 * |       ESP32-CAM Hellboy's WatchTower Surveillance Dashboard (Green)      |
 * |          Hardware : AI Thinker ESP32-CAM  |  OV2640  |  HW-381 MB        |
 * |             Version  : 1.0.0                                             |
 * +==========================================================================+
 * |  REQUIRED LIBRARIES (Arduino IDE -> Manage Libraries):                   |
 * |    - "Universal Arduino Telegram Bot"  by Brian Lough                    |
 * |    - "ArduinoJson"                     by Benoit Blanchon  (v6.x)        |
 * |                                                                          |
 * |  BOARD SETTINGS:                                                         |
 * |    Board            : AI Thinker ESP32-CAM                               |
 * |    Partition Scheme : Huge APP (3MB No OTA / 1MB SPIFFS)                 |
 * |    CPU Frequency    : 240 MHz                                            |
 * |    Upload Speed     : 115200                                             |
 * +==========================================================================+
 */

// ============================================================
//  USER CONFIGURATION -- Fill in before flashing
// ============================================================
// WiFi + Telegram credentials loaded from Preferences (NVS) at boot.
// Configure via dashboard Settings panel. No hardcoded credentials.
#define AP_SSID     "ESP32HBWT"
#define AP_PASS     "watchtower"
#define AP_IP_STR   "192.168.4.1"

// Motion Detection - THESE ARE THE TUNED DEFAULTS
// mdThreshold: mean absolute difference of grayscale values (0-255)
//   lower  = more sensitive (fires easier)
//   higher = less sensitive (only fires on big movement)
//   Good range: 4.0 (very sensitive) to 20.0 (only large motion)
#define MD_THRESHOLD_DEFAULT    8.0f   // MAD trigger level
#define MOTION_SENSITIVITY_DEFAULT  50  // 1-100 slider position for above
#define MOTION_COOLDOWN_DEFAULT_S    8  // seconds between repeated alerts
#define MD_WARMUP_FRAMES           20  // frames to discard at startup / arm

#define NTP_SERVER          "pool.ntp.org"
// POSIX TZ string handles DST transitions automatically.
// Change this to match your timezone. Examples:
//   Central European : "CET-1CEST,M3.5.0,M10.5.0/3"
//   UK               : "GMT0BST,M3.5.0/1,M10.5.0"
//   US Eastern       : "EST5EDT,M3.2.0,M11.1.0"
//   US Pacific       : "PST8PDT,M3.2.0,M11.1.0"
#define POSIX_TZ            "CET-1CEST,M3.5.0,M10.5.0/3"

// -- Camera quality tuning -------------------------------------
// JPEG quality: lower number = higher quality / larger file
//   Stream: 12 keeps frames small for smooth WiFi delivery
//   Photo:  8 gives good detail without exhausting PSRAM
// Photo resolution: SVGA (800x600) is reliable on this hardware.
// UXGA (1600x1200) often produces blank frames due to PSRAM limits.
#define STREAM_JPEG_QUALITY   12
#define PHOTO_JPEG_QUALITY     6
#define PHOTO_FRAMESIZE        FRAMESIZE_XGA    // 1024x768 - good quality still
// ============================================================

#include "esp_camera.h"
#include "img_converters.h"
#include "Arduino.h"
#include "soc/soc.h"
#include "soc/rtc_cntl_reg.h"
#include "driver/rtc_io.h"
#include <WiFi.h>
#include <WiFiClientSecure.h>
#include <WebServer.h>
#include <SD_MMC.h>
#include <FS.h>
#include <Preferences.h>
#include <time.h>
#include <esp_http_server.h>
#include <UniversalTelegramBot.h>
#include <ArduinoJson.h>
#include <vector>
#include <algorithm>

// ============================================================
//  AI THINKER PIN MAP
// ============================================================
#define PWDN_GPIO_NUM   32
#define RESET_GPIO_NUM  -1
#define XCLK_GPIO_NUM    0
#define SIOD_GPIO_NUM   26
#define SIOC_GPIO_NUM   27
#define Y9_GPIO_NUM     35
#define Y8_GPIO_NUM     34
#define Y7_GPIO_NUM     39
#define Y6_GPIO_NUM     36
#define Y5_GPIO_NUM     21
#define Y4_GPIO_NUM     19
#define Y3_GPIO_NUM     18
#define Y2_GPIO_NUM      5
#define VSYNC_GPIO_NUM  25
#define HREF_GPIO_NUM   23
#define PCLK_GPIO_NUM   22
#define FLASH_LED_PIN    4
// LEDC channel for flash LED PWM - must not conflict with camera LEDC_CHANNEL_0
// Camera uses LEDC_CHANNEL_0 for XCLK. We use channel 1 for the flash LED.
#define FLASH_LEDC_CHANNEL  1
#define FLASH_LEDC_FREQ     5000   // 5 kHz - same as CameraWebServer
#define FLASH_LEDC_RES      8      // 8-bit = 0-255
static int ledDuty = 0;  // current LED PWM duty (0=off, 255=full)

// ============================================================
//  MOTION DETECTION BUFFERS
//  JPG_SCALE_8X: VGA 640x480  ?  80x60 grayscale = 4800 bytes
//  Using 8x scale (not 4x) makes the diff faster and less noisy
// ============================================================
#define MD_W       80
#define MD_H       60
#define MD_PIXELS  (MD_W * MD_H)     // 4800

// Each buffer holds one grayscale frame (1 byte per pixel)
static uint8_t* prevGray       = nullptr;
static uint8_t* currGray       = nullptr;
static bool     prevFrameReady = false;

// Warm-up counter - discard first N frames after arming
static int  mdWarmupCount  = 0;
static bool mdWarmedUp     = false;

// Consecutive-hit counter - require 2 hits before firing
static int  mdConsecutive  = 0;
#define MD_CONSEC_REQUIRED  2

// Actual float threshold derived from slider
static float mdThreshold = MD_THRESHOLD_DEFAULT;

// ============================================================
//  AVI WRITER
// ============================================================
#define AVI_MAX_FRAMES 3000
static File     aviFile;
// Note: idx1 index chunk is not written (dwFlags=0x00 in avih).
// The offset/size arrays were previously allocated but never used.
// 24 KB of PSRAM freed back to camera buffers and WiFi stack.
static int      aviFrameCount   = 0;
static unsigned long aviStartMs = 0;
static bool     aviRecording    = false;
static char     aviFilePath[96] = "";
static uint32_t aviMoviOffset   = 0;
// Actual pixel dimensions extracted from first frame's JPEG header
static int      aviWidth        = 640;
static int      aviHeight       = 480;

// ============================================================
//  GLOBAL STATE
// ============================================================
volatile bool  streamActive      = false;
bool  motionArmed       = false;   // ? OFF by default (v2.2 fix)
bool  telegramEnabled   = false;  // enabled once credentials loaded from NVS
bool  emailEnabled      = false;  // reserved for future email alert feature
// Runtime credentials - loaded from Preferences in setup()
static String cfgWifiSSID  = "";
static String cfgWifiPass  = "";
static String cfgBotToken  = "";
static String cfgChatID    = "";
static bool   apMode       = false;  // true when running as AP (no router)

int   motionSensitivity = MOTION_SENSITIVITY_DEFAULT;
int   motionCooldownS   = MOTION_COOLDOWN_DEFAULT_S;

unsigned long lastMotionMs   = 0;
unsigned long lastTelegramMs = 0;
unsigned long bootMs         = 0;   // set in setup() for uptime tracking

// ── Timelapse ──────────────────────────────────────────────────
bool          timelapseActive   = false;
int           timelapseIntervalS = 30;   // seconds between captures
unsigned long lastTimelapseMs   = 0;

int photoCount = 0;
int videoCount = 0;

// OPT: Events list cache - avoids full SD directory scan on every /api/events call.
// Set dirty whenever photoCount or videoCount changes (capture, delete, deleteAll).
static bool   eventsCacheDirty = true;   // force scan on first request
static int    eventsCachePhotoSnap = -1; // photoCount snapshot at last scan
static int    eventsCacheVideoSnap = -1; // videoCount snapshot at last scan

// Stream quality settings (changeable from dashboard)
// framesize_t values: FRAMESIZE_QVGA=5, VGA=8, SVGA=9, XGA=10, SXGA=12, UXGA=13
int  streamFrameSize = FRAMESIZE_VGA;   // default VGA
int  streamFps       = 10;              // default 10 fps

// Events pagination - limit displayed to avoid memory exhaustion
#define EVENTS_PAGE_SIZE  20

httpd_handle_t      streamHttpd = NULL;
Preferences         preferences;
WebServer           webServer(80);
WiFiClientSecure    securedClient;
UniversalTelegramBot* bot = nullptr;

// -- Telegram background task -----------------------------------
// All Telegram I/O runs on Core 0. loop() on Core 1 never blocks.
typedef enum { TG_TEXT, TG_PHOTO, TG_VIDEO } TgJobType;
// OPT: union payload - path/caption and text are mutually exclusive by job type.
// Saves ~640 bytes per queue slot = ~3.5KB total queue SRAM vs the old flat struct.
struct TgJob {
  TgJobType type;
  union {
    struct {
      char path[128];    // SD path (PHOTO/VIDEO jobs)
      char caption[384]; // caption (PHOTO/VIDEO jobs) - was 512, trimmed to fit union
    };
    char text[512];      // body (TG_TEXT jobs)
  };
};
static QueueHandle_t     tgQueue    = nullptr;  // created in setup()
static SemaphoreHandle_t sdMutex    = nullptr;  // guards all SD_MMC calls
static SemaphoreHandle_t tgBusySem  = nullptr;  // binary sem: taken while TLS send in progress
// tgBusySem serialises all TLS operations within telegramTask.
// Only one mbedTLS session runs at a time - two simultaneous sessions
// exhaust heap and cause silent failures.

// -- Pending-job state machine (Item 5) -------------------------
// HTTP handlers are called from webServer.handleClient() on the main
// task. Heavy work (photo/record) sets a pending flag and returns
// immediately so handleClient() never blocks for 2-30 seconds.
// loop() checks and executes pending jobs each iteration.
typedef enum { JOB_NONE, JOB_PHOTO, JOB_RECORD } PendingJobType;
struct PendingJob {
  PendingJobType type     = JOB_NONE;
  bool           flash    = false;
  int            recSecs  = 10;
};
static volatile PendingJob pendingJob;


// ============================================================
//  FORWARD DECLARATIONS
// ============================================================
void   tgEnqueue(const String& msg);
void   tgEnqueuePhoto(const String& path, const String& cap);
void   tgEnqueueVideo(const String& path, const String& cap);
void   tgSend(const String& msg);
void   executePendingJob();
void   sendPhotoToTelegram(const String& filePath, const String& caption);
void   sendVideoToTelegram(const String& filePath, const String& caption);
bool   captureAndSavePhoto(bool sendTg, String triggerLabel, bool useFlash);
bool   startAVIRecording(int durationSec);
bool   addAVIFrame(camera_fb_t* fb);
String finishAVIRecording();
bool   checkMotion(camera_fb_t* fb);
int    countPhotos();
int    countVideos();
String getTimestamp();
String getUptime();
void   runTelegramRecord(int secs);
void   armMotion();
void   disarmMotion();
void   applyStreamResolution();
void   deleteAllSD();
// Convert slider 1-100 -> float threshold (inverse: high slider = low threshold)
inline float sliderToThreshold(int s) {
  // slider 1   -> ~13.88  (least sensitive, barely triggers)
  // slider 50  ->   8.0   (default, matches MD_THRESHOLD_DEFAULT)
  // slider 100 ->   2.0   (most sensitive)
  return 14.0f - (s * 12.0f / 100.0f);
}

// ============================================================
//  EMBEDDED WEB DASHBOARD - gzip-compressed (73% smaller)
// ============================================================
// Dashboard HTML gzip-compressed: 11285 bytes (was 31292 bytes plain)
static const uint16_t DASHBOARD_HTML_GZ_LEN = 13367;
static const uint8_t  DASHBOARD_HTML_GZ[] PROGMEM = {
  0x1f,0x8b,0x08,0x00,0x07,0x5b,0xbb,0x69,0x02,0xff,0xdd,0x7d,0x6b,0x8f,0x1b,0x49,
  0x92,0xd8,0x77,0xfd,0x8a,0x1c,0x0e,0x56,0x24,0x57,0x24,0xbb,0xf8,0xe8,0x16,0x9b,
  0xec,0x6e,0x6d,0xbf,0xd4,0xea,0x59,0x75,0xab,0x47,0xdd,0x92,0x66,0xa4,0x1d,0x08,
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  0xce,0x8a,0x19,0x38,0xd8,0x00,0x00
};


// ============================================================
//  CAMERA INIT
//  The OV2640 on AI-Thinker / HW-381 boards cannot have its
//  frame-size changed via set_framesize() while the DMA/I2S
//  capture engine is running - doing so causes FB-OVF errors.
//  The ONLY safe approach is full deinit ? reinit with the new
//  config.  initCameraMode() encapsulates that.
// ============================================================

// Build camera_config_t for a given mode
static camera_config_t buildCamConfig(framesize_t fs, int quality, int fbCount) {
  camera_config_t cfg;
  cfg.ledc_channel = LEDC_CHANNEL_0;
  cfg.ledc_timer   = LEDC_TIMER_0;
  cfg.pin_d0  = Y2_GPIO_NUM; cfg.pin_d1  = Y3_GPIO_NUM;
  cfg.pin_d2  = Y4_GPIO_NUM; cfg.pin_d3  = Y5_GPIO_NUM;
  cfg.pin_d4  = Y6_GPIO_NUM; cfg.pin_d5  = Y7_GPIO_NUM;
  cfg.pin_d6  = Y8_GPIO_NUM; cfg.pin_d7  = Y9_GPIO_NUM;
  cfg.pin_xclk     = XCLK_GPIO_NUM;
  cfg.pin_pclk     = PCLK_GPIO_NUM;
  cfg.pin_vsync    = VSYNC_GPIO_NUM;
  cfg.pin_href     = HREF_GPIO_NUM;
  cfg.pin_sccb_sda = SIOD_GPIO_NUM;
  cfg.pin_sccb_scl = SIOC_GPIO_NUM;
  cfg.pin_pwdn     = PWDN_GPIO_NUM;
  cfg.pin_reset    = RESET_GPIO_NUM;
  cfg.xclk_freq_hz = 20000000;
  cfg.pixel_format = PIXFORMAT_JPEG;
  cfg.frame_size   = fs;
  cfg.jpeg_quality = quality;
  cfg.fb_count     = fbCount;
  if (psramFound()) {
    cfg.fb_location = CAMERA_FB_IN_PSRAM;
    // LATEST mode: newest frame always available, older ones auto-discarded
    // - prevents FB-OVF during streaming
    cfg.grab_mode = (fbCount > 1) ? CAMERA_GRAB_LATEST : CAMERA_GRAB_WHEN_EMPTY;
  } else {
    cfg.fb_location = CAMERA_FB_IN_DRAM;
    cfg.grab_mode   = CAMERA_GRAB_WHEN_EMPTY;
  }
  return cfg;
}

// Full deinit + reinit - the only safe way to change resolution
bool initCameraMode(framesize_t fs, int quality, int fbCount) {
  esp_camera_deinit();
  delay(100);   // let DMA/I2S engine fully stop
  camera_config_t cfg = buildCamConfig(fs, quality, fbCount);
  esp_err_t err = esp_camera_init(&cfg);
  if (err != ESP_OK) {
    Serial.printf("[CAM] Reinit FAILED 0x%x\n", err);
    return false;
  }
  Serial.printf("[CAM] Mode: fs=%d q=%d fb=%d\n", (int)fs, quality, fbCount);
  return true;
}

// First-time init on boot (stream mode: VGA, 2 buffers for GRAB_LATEST)
bool initCamera() {
  framesize_t fs = psramFound() ? (framesize_t)streamFrameSize : FRAMESIZE_VGA;
  int quality    = psramFound() ? 10 : 12;
  int fbCount    = psramFound() ? 2  : 1;
  camera_config_t cfg = buildCamConfig(fs, quality, fbCount);
  esp_err_t err = esp_camera_init(&cfg);
  if (err != ESP_OK) { Serial.printf("📷 FAILED 0x%x\n", err); return false; }
  Serial.printf("[CAM] Boot: VGA MJPEG PSRAM=%d\n", (int)psramFound());
  return true;
}


// ============================================================
//  CAMERA SETTINGS HELPERS
// ============================================================

bool initSD() {
  if (!SD_MMC.begin("/sdcard", true)) { Serial.println("💾 Failed"); return false; }
  if (SD_MMC.cardType() == CARD_NONE) { Serial.println("💾 No card"); return false; }
  Serial.printf("[SD] Ready %.1f GB\n",
    (float)SD_MMC.totalBytes() / (1024.0*1024*1024));
  return true;
}

// ============================================================
//  HELPERS
// ============================================================
String getTimestamp() {
  struct tm ti;
  if (!getLocalTime(&ti)) {
    char buf[20]; snprintf(buf, sizeof(buf), "notime_%lu", millis()/1000);
    return String(buf);
  }
  char buf[22]; strftime(buf, sizeof(buf), "%Y-%m-%d_%H-%M-%S", &ti);
  return String(buf);
}

String getResLabel(int fs) {
  switch(fs) {
    case 1:  return "QQVGA";
    case 5:  return "QVGA";
    case 8:  return "VGA";
    case 9:  return "SVGA";
    case 10: return "XGA";
    case 11: return "HD";
    case 12: return "SXGA";
    case 13: return "UXGA";
    default: return "VGA";
  }
}

String getUptime() {
  unsigned long elapsed = (millis() - bootMs) / 1000;
  unsigned long h = elapsed / 3600;
  unsigned long m = (elapsed % 3600) / 60;
  char buf[16];
  snprintf(buf, sizeof(buf), "%luh %lum", h, m);
  return String(buf);
}

void applyStreamResolution() {
  int fbCount = psramFound() ? 2 : 1;
  initCameraMode((framesize_t)streamFrameSize, STREAM_JPEG_QUALITY, fbCount);
  Serial.printf("[CAM] Stream mode: res=%d(%s) fps=%d\n",
    streamFrameSize, getResLabel(streamFrameSize).c_str(), streamFps);
}

// Delete all files in /photos and /videos
void deleteAllSD() {
  if(sdMutex) xSemaphoreTake(sdMutex, portMAX_DELAY);
  auto rmDir = [](const char* dir) -> int {
    int count = 0;
    File root = SD_MMC.open(dir);
    if (!root || !root.isDirectory()) return 0;
    File f = root.openNextFile();
    while (f) {
      if (!f.isDirectory()) {
        String path = String(dir) + "/" + String(f.name());
        f.close();
        SD_MMC.remove(path.c_str());
        count++;
        f = root.openNextFile();
      } else {
        f.close();  // explicitly close directory handles before moving to next entry
        f = root.openNextFile();
      }
    }
    root.close();
    return count;
  };
  int n = rmDir("/photos") + rmDir("/videos");
  if(sdMutex) xSemaphoreGive(sdMutex);
  photoCount = 0; videoCount = 0;
  Serial.printf("[SD] Deleted all: %d files\n", n);
}

int countPhotos() {
  int c=0; File r=SD_MMC.open("/photos");
  if (r&&r.isDirectory()){File f=r.openNextFile();while(f){if(!f.isDirectory())c++;f=r.openNextFile();}}
  if(r) r.close();
  return c;
}
int countVideos() {
  int c=0; File r=SD_MMC.open("/videos");
  if (r&&r.isDirectory()){File f=r.openNextFile();while(f){if(!f.isDirectory())c++;f=r.openNextFile();}}
  if(r) r.close();
  return c;
}

// ============================================================
//  ARM / DISARM  - resets warm-up and consecutive counters
// ============================================================
void armMotion() {
  motionArmed       = true;
  prevFrameReady    = false;   // force fresh baseline on first frame
  mdWarmupCount     = 0;
  mdWarmedUp        = false;
  mdConsecutive     = 0;
  Serial.println("[MD] ARMED - warm-up started");
}

void disarmMotion() {
  motionArmed    = false;
  mdWarmedUp     = false;
  mdConsecutive  = 0;
  Serial.println("[MD] DISARMED");
}

// ============================================================
//  TELEGRAM HELPERS
// ============================================================
// --- Non-blocking Telegram enqueue helpers ----------------------
void tgEnqueue(const String& msg) {
  if (!tgQueue || !telegramEnabled) return;
  TgJob job; job.type = TG_TEXT;
  strlcpy(job.text, msg.c_str(), sizeof(job.text));
  xQueueSend(tgQueue, &job, 0);
}
void tgEnqueuePhoto(const String& path, const String& cap) {
  if (!tgQueue || !telegramEnabled) return;
  TgJob job; job.type = TG_PHOTO;
  strlcpy(job.path,    path.c_str(), sizeof(job.path));
  strlcpy(job.caption, cap.c_str(),  sizeof(job.caption));
  xQueueSend(tgQueue, &job, 0);
}
void tgEnqueueVideo(const String& path, const String& cap) {
  if (!tgQueue || !telegramEnabled) return;
  TgJob job; job.type = TG_VIDEO;
  strlcpy(job.path,    path.c_str(), sizeof(job.path));
  strlcpy(job.caption, cap.c_str(),  sizeof(job.caption));
  xQueueSend(tgQueue, &job, 0);
}
// Legacy alias: all existing tgSend() call-sites compile unchanged
inline void tgSend(const String& msg) { tgEnqueue(msg); }

// --- Telegram worker - runs forever on Core 0 -------------------
// sendPhotoToTelegram / sendVideoToTelegram called ONLY from here.
void telegramTask(void*) {
  unsigned long lastPollMs = 0;
  for (;;) {
    // Use a 500ms queue timeout so we can also poll for incoming Telegram
    // commands on Core 0 without blocking Core 1's main loop at all.
    TgJob job;
    if (xQueueReceive(tgQueue, &job, pdMS_TO_TICKS(500)) == pdTRUE) {
      if (!bot || !telegramEnabled) { vTaskDelay(pdMS_TO_TICKS(10)); continue; }
      xSemaphoreTake(tgBusySem, portMAX_DELAY);
      switch (job.type) {
        case TG_TEXT:  bot->sendMessage(cfgChatID.c_str(), String(job.text), ""); break;
        case TG_PHOTO: sendPhotoToTelegram(String(job.path), String(job.caption)); break;
        case TG_VIDEO:
          vTaskDelay(pdMS_TO_TICKS(3000));
          sendVideoToTelegram(String(job.path), String(job.caption));
          break;
      }
      xSemaphoreGive(tgBusySem);
      vTaskDelay(pdMS_TO_TICKS(200));
    }

    // Poll for incoming Telegram commands here on Core 0 every 2 seconds.
    // Previously this ran in loop() on Core 1, blocking it with a full
    // HTTPS round-trip every 2s and starving the stream task.
    if (!bot || !telegramEnabled) continue;
    unsigned long now = millis();
    if (now - lastPollMs < 2000) continue;
    lastPollMs = now;
    xSemaphoreTake(tgBusySem, portMAX_DELAY);
    int n = bot->getUpdates(bot->last_message_received + 1);
    xSemaphoreGive(tgBusySem);
    while (n) {
      for (int i = 0; i < n; i++) {
        String text = bot->messages[i].text;
        if (bot->messages[i].chat_id != cfgChatID) continue;
        Serial.println("[TG] " + text);
        if (text == "/help" || text == "/start") {
          bot->sendMessage(cfgChatID.c_str(),
            "\xF0\x9F\x93\xB7 *ESP32-CAM Surveillance - Help Menu*\n\n"
            "\xF0\x9F\x93\xB8 /photo - Capture hi-res photo (no flash)\n"
            "\xE2\x9A\xA1 /photoflash - Capture hi-res photo WITH flash\n"
            "\xF0\x9F\x8E\xA5 /video - Record 10s AVI video\n"
            "\xF0\x9F\x8E\xAC /record30 - Record 30s AVI video\n"
            "\xF0\x9F\x93\x8A /status - Full system status\n"
            "\xF0\x9F\x94\x92 /arm - Arm motion detection\n"
            "\xF0\x9F\x94\x93 /disarm - Disarm motion detection\n"
            "\xF0\x9F\x92\xBE /storage - SD card storage info\n"
            "\xF0\x9F\x94\x84 /restart - Restart the ESP32\n"
            "\xE2\x9D\x93 /help - Show this menu\n\n"
            "\xF0\x9F\x92\xA1 _Dashboard: http://" + WiFi.localIP().toString() + "_", "Markdown");
        }
        else if (text == "/photo") {
          tgSend("\xF0\x9F\x93\xB8 Capturing hi-res photo (no flash)...");
          pendingJob.flash = false; pendingJob.type = JOB_PHOTO;
        }
        else if (text == "/photoflash") {
          tgSend("\xE2\x9A\xA1 Capturing hi-res photo WITH flash...");
          pendingJob.flash = true; pendingJob.type = JOB_PHOTO;
        }
        else if (text == "/video")    { pendingJob.recSecs = 10; pendingJob.type = JOB_RECORD; }
        else if (text == "/record30") { pendingJob.recSecs = 30; pendingJob.type = JOB_RECORD; }
        else if (text == "/status") {
          float temp = temperatureRead();
          unsigned long lm = (millis() - lastMotionMs) / 1000;
          bot->sendMessage(cfgChatID.c_str(),
            "\xF0\x9F\x8C\x90 *Network Status:*\n"
            "\xF0\x9F\x93\xB6 WiFi: Connected \xE2\x9C\x85\n"
            "\xF0\x9F\x93\xB1 IP: " + WiFi.localIP().toString() + "\n"
            "\xF0\x9F\x93\xA1 RSSI: " + String(WiFi.RSSI()) + " dBm\n"
            "\xF0\x9F\x8C\xA1 Temp: " + String(temp, 1) + " degC\n\n"
            "\xF0\x9F\x93\xB7 *Camera:*\n"
            "\xF0\x9F\x8E\xA5 Stream: " + getResLabel(streamFrameSize) + " @" + String(streamFps) + "fps\n"
            "\xF0\x9F\x93\xB8 Photos: " + String(photoCount) + "\n"
            "\xF0\x9F\x94\xB4 Recording: " + (aviRecording ? "ACTIVE" : "IDLE") + "\n\n"
            "\xF0\x9F\x8F\x83 *Motion Detection:*\n"
            "\xF0\x9F\x94\x8D Status: " + (motionArmed ? "ARMED \xF0\x9F\x9F\xA2" : "DISARMED \xF0\x9F\x94\xB4") + "\n"
            "\xF0\x9F\x8E\x9A Sensitivity: " + String(motionSensitivity) + "\n"
            "\xE2\x8F\xB1 Cooldown: " + String(motionCooldownS) + "s\n"
            "\xF0\x9F\x95\x90 Last alert: " + String(lm) + "s ago", "Markdown");
        }
        else if (text == "/arm")    { armMotion();    tgSend("\xF0\x9F\x94\x92 Motion *ARMED* \xF0\x9F\x9F\xA2"); }
        else if (text == "/disarm") { disarmMotion(); tgSend("\xF0\x9F\x94\x93 Motion *DISARMED*"); }
        else if (text == "/storage") {
          uint64_t tot = SD_MMC.totalBytes(), used = SD_MMC.usedBytes();
          String sdt = "Unknown";
          switch (SD_MMC.cardType()) {
            case CARD_MMC:  sdt = "MMC";        break;
            case CARD_SD:   sdt = "SDSC";       break;
            case CARD_SDHC: sdt = "SDHC/SDXC"; break;
            default: break;
          }
          bot->sendMessage(cfgChatID.c_str(),
            "\xF0\x9F\x92\xBE *SD Card:*\n"
            "Type: " + sdt + "\n"
            "Total: " + String((uint32_t)(tot / (1024*1024))) + " MB\n"
            "Used: "  + String((uint32_t)(used / (1024*1024))) + " MB\n"
            "Free: "  + String((uint32_t)((tot-used) / (1024*1024))) + " MB\n"
            "Photos: " + String(photoCount) + "  Videos: " + String(videoCount), "Markdown");
        }
        else if (text == "/restart") {
          tgSend("\xF0\x9F\x94\x84 Restarting now...");
          vTaskDelay(pdMS_TO_TICKS(500)); ESP.restart();
        }
        else { tgSend("\xE2\x9D\x93 Unknown command. Send /help for menu."); }
      }
      xSemaphoreTake(tgBusySem, portMAX_DELAY);
      n = bot->getUpdates(bot->last_message_received + 1);
      xSemaphoreGive(tgBusySem);
    }
  }
}


void sendPhotoToTelegram(const String& filePath, const String& caption) {
  if (!telegramEnabled) return;

  // Step 1: get file size under mutex (fast - just a stat)
  if (sdMutex) xSemaphoreTake(sdMutex, portMAX_DELAY);
  File fSize = SD_MMC.open(filePath.c_str(), FILE_READ);
  size_t sz = fSize ? fSize.size() : 0;
  if (fSize) fSize.close();
  if (sdMutex) xSemaphoreGive(sdMutex);
  if (sz == 0) { Serial.println("[TG] Photo: file not found or empty"); return; }

  // Step 2: TLS connect (1-3s) - NO mutex held, main loop runs freely
  // Retry up to 3 times with 2s delay - camera reinit can briefly disturb WiFi stack
  WiFiClientSecure cl; cl.setCACert(TELEGRAM_CERTIFICATE_ROOT);
  bool tlsOk = false;
  for (int attempt = 1; attempt <= 3; attempt++) {
    if (cl.connect("api.telegram.org", 443, 15000)) { tlsOk = true; break; }
    Serial.printf("[TG] Photo: TLS connect failed (attempt %d/3)\n", attempt);
    if (attempt < 3) { cl.stop(); delay(2000); }
  }
  if (!tlsOk) { Serial.println("[TG] Photo: all TLS attempts failed"); return; }


  // Step 3: send HTTP headers
  const String bd = "ESP32PB123";
  String head =
    "--"+bd+"\r\nContent-Disposition: form-data; name=\"chat_id\"\r\n\r\n"+cfgChatID+"\r\n"
    "--"+bd+"\r\nContent-Disposition: form-data; name=\"caption\"\r\n\r\n"+caption+"\r\n"
    "--"+bd+"\r\nContent-Disposition: form-data; name=\"photo\"; filename=\"p.jpg\"\r\n"
    "Content-Type: image/jpeg\r\n\r\n";
  String tail = "\r\n--"+bd+"--\r\n";
  cl.printf("POST /bot%s/sendPhoto HTTP/1.1\r\nHost: api.telegram.org\r\n"
            "Content-Type: multipart/form-data; boundary=%s\r\n"
            "Content-Length: %u\r\nConnection: close\r\n\r\n",
            cfgBotToken.c_str(), bd.c_str(), (unsigned)(head.length()+sz+tail.length()));
  cl.print(head);

  // Step 4: stream file bytes - take mutex only for the SD read portion
  // OPT: Use 8KB chunks instead of 1KB to reduce mutex lock/unlock cycles
  // from ~200 to ~25 for a typical 200KB photo. SD bus is idle during cl.write()
  // so the tight acquire-read-release-write-acquire loop was pure overhead.
  if (sdMutex) xSemaphoreTake(sdMutex, portMAX_DELAY);
  File f = SD_MMC.open(filePath.c_str(), FILE_READ);
  if (!f) { if(sdMutex) xSemaphoreGive(sdMutex); cl.stop(); return; }
  uint8_t buf[8192];
  while (f.available()) {
    int n = f.read(buf, sizeof(buf));
    if (sdMutex) xSemaphoreGive(sdMutex);
    cl.write(buf, n);               // TLS write outside mutex
    if (sdMutex) xSemaphoreTake(sdMutex, portMAX_DELAY);
  }
  f.close();
  if (sdMutex) xSemaphoreGive(sdMutex);

  // Step 5: send closing boundary and drain response
  cl.print(tail);
  unsigned long t=millis(); while(!cl.available()&&millis()-t<15000) delay(10);
  while(cl.available()) cl.read();
  cl.stop();
  Serial.println("[TG] Photo sent OK");
}

void sendVideoToTelegram(const String& filePath, const String& caption) {
  if (!telegramEnabled) return;
  String fname = filePath.substring(filePath.lastIndexOf('/')+1);

  // Step 1: get file size under mutex
  if (sdMutex) xSemaphoreTake(sdMutex, portMAX_DELAY);
  File fSize = SD_MMC.open(filePath.c_str(), FILE_READ);
  size_t sz = fSize ? fSize.size() : 0;
  if (fSize) fSize.close();
  if (sdMutex) xSemaphoreGive(sdMutex);
  if (sz == 0) { Serial.println("[TG] Video: file not found or empty"); return; }

  // Step 2: TLS connect - no mutex held
  // Retry up to 3 times with 2s delay - camera reinit can briefly disturb WiFi stack
  WiFiClientSecure cl; cl.setCACert(TELEGRAM_CERTIFICATE_ROOT);
  bool tlsOk = false;
  for (int attempt = 1; attempt <= 3; attempt++) {
    if (cl.connect("api.telegram.org", 443, 20000)) { tlsOk = true; break; }
    Serial.printf("[TG] Video: TLS connect failed (attempt %d/3)\n", attempt);
    if (attempt < 3) { cl.stop(); delay(2000); }
  }
  if (!tlsOk) { Serial.println("[TG] Video: all TLS attempts failed"); return; }


  // Step 3: send HTTP headers
  const String bd = "ESP32VB456";
  String head =
    "--"+bd+"\r\nContent-Disposition: form-data; name=\"chat_id\"\r\n\r\n"+cfgChatID+"\r\n"
    "--"+bd+"\r\nContent-Disposition: form-data; name=\"caption\"\r\n\r\n"+caption+"\r\n"
    "--"+bd+"\r\nContent-Disposition: form-data; name=\"document\"; filename=\""+fname+"\"\r\n"
    "Content-Type: video/x-msvideo\r\n\r\n";
  String tail = "\r\n--"+bd+"--\r\n";
  cl.printf("POST /bot%s/sendDocument HTTP/1.1\r\nHost: api.telegram.org\r\n"
            "Content-Type: multipart/form-data; boundary=%s\r\n"
            "Content-Length: %u\r\nConnection: close\r\n\r\n",
            cfgBotToken.c_str(), bd.c_str(), (unsigned)(head.length()+sz+tail.length()));
  cl.print(head);

  // Step 4: stream file bytes - release mutex between chunks
  // vTaskDelay every 20 chunks feeds the watchdog on Core 0 during long uploads.
  if (sdMutex) xSemaphoreTake(sdMutex, portMAX_DELAY);
  File f = SD_MMC.open(filePath.c_str(), FILE_READ);
  if (!f) { if(sdMutex) xSemaphoreGive(sdMutex); cl.stop(); return; }
  uint8_t buf[2048];
  int chunkCount = 0;
  while (f.available()) {
    int n = f.read(buf, sizeof(buf));
    if (sdMutex) xSemaphoreGive(sdMutex);
    cl.write(buf, n);
    chunkCount++;
    if (chunkCount % 20 == 0) {
      vTaskDelay(pdMS_TO_TICKS(10));  // yield to IDLE0 - feeds task watchdog
    }
    if (sdMutex) xSemaphoreTake(sdMutex, portMAX_DELAY);
  }
  f.close();
  if (sdMutex) xSemaphoreGive(sdMutex);

  // Step 5: closing boundary and drain
  cl.print(tail);
  unsigned long t=millis(); while(!cl.available()&&millis()-t<30000) delay(10);
  while(cl.available()) cl.read();
  cl.stop();
  Serial.println("[TG] Video sent OK");
}

// ============================================================
//  PHOTO CAPTURE - safe high-resolution still
//
//  Strategy: deinit camera ? reinit at UXGA ? capture ? reinit
//  back to stream config. This is the ONLY way to switch resolution
//  reliably on this hardware without FB-OVF errors.
//
//  Stream is stopped before deinit and restored after reinit.
// ============================================================
bool captureAndSavePhoto(bool sendTg, String triggerLabel, bool useFlash) {
  // -- 1. Stop stream and disarm motion ---------------------
  bool wasStreaming = streamActive;
  bool wasArmed     = motionArmed;
  streamActive = false;
  motionArmed  = false;
  delay(200);   // give httpd stream task time to finish its current frame

  // -- 2. Reinit camera at SVGA for reliable high-res still -----
  // SVGA (800x600, quality=8): 2x VGA area, fast AE settle, no blank frames.
  // UXGA was tried but caused blank frames on this hardware due to PSRAM limits.
  bool reinitOk = initCameraMode(PHOTO_FRAMESIZE, PHOTO_JPEG_QUALITY, 1);
  if (!reinitOk) {
    Serial.println("[CAM] Photo reinit failed, trying VGA fallback");
    reinitOk = initCameraMode(FRAMESIZE_VGA, PHOTO_JPEG_QUALITY, 1);
  }
  delay(350);   // OV2640 AE/AWB needs time to settle at new resolution

  // -- 3. Warm-up: discard 3 frames so AE/AWB fully settles ----
  for (int i = 0; i < 3; i++) {
    camera_fb_t* flush = esp_camera_fb_get();
    if (flush) esp_camera_fb_return(flush);
    delay(120);
  }

  // -- 4. Flash on -> discard pre-flash buffer -> capture -> flash off ----
  //
  // The OV2640 JPEG pipeline is double-buffered. When you turn the flash on
  // and immediately call esp_camera_fb_get(), you receive the frame that was
  // ALREADY being exposed before the flash fired. You need to:
  //   a) Turn flash ON
  //   b) Discard one frame (the one exposed without flash)
  //   c) Capture the next frame (now fully lit by the flash)
  //   d) Turn flash OFF
  //
  if (useFlash) {
    ledcWrite(FLASH_LED_PIN, 255);
    delay(50);   // let flash reach full brightness
    // Discard the frame that was buffered before flash fired
    camera_fb_t* preflash = esp_camera_fb_get();
    if (preflash) esp_camera_fb_return(preflash);
    delay(30);   // one extra frame period at ~15fps
  }
  camera_fb_t* fb = esp_camera_fb_get();
  if (useFlash) {
    ledcWrite(FLASH_LED_PIN, ledDuty);  // restore previous duty after flash
  }

  // -- 5. Save to SD -----------------------------------------
  bool ok = false;
  String path = "";
  if (fb) {
    if (sdMutex) xSemaphoreTake(sdMutex, portMAX_DELAY);
    SD_MMC.mkdir("/photos");
    path = "/photos/" + getTimestamp() + ".jpg";
    File out = SD_MMC.open(path.c_str(), FILE_WRITE);
    if (out) {
      out.write(fb->buf, fb->len);
      out.close();
      ok = true;
    }
    if (sdMutex) xSemaphoreGive(sdMutex);
    Serial.printf("[CAM] Saved %s (%u bytes, flash=%d)\n",
                  path.c_str(), (unsigned)fb->len, (int)useFlash);
    esp_camera_fb_return(fb);
    photoCount++;  // increment in-place; full rescan only at boot / deleteAllSD()
  } else {
    Serial.println("[CAM] Capture failed - fb==NULL");
  }

  // -- 6. Reinit camera back to stream mode -----------------
  {
    int fbCount = psramFound() ? 2 : 1;
    initCameraMode((framesize_t)streamFrameSize, STREAM_JPEG_QUALITY, fbCount);
  }
  delay(150);

  // Restore stream and motion state
  streamActive = wasStreaming;
  motionArmed  = wasArmed;
  if (wasArmed) { prevFrameReady = false; }   // reset motion baseline

  // -- 7. Send to Telegram with combined caption -------------
  if (ok && sendTg && telegramEnabled && bot) {
    String cap =
      "📸 Photo captured!\n"
      "📊 Photo #" + String(photoCount) + "\n"
      "💾 Saved to SD ✅\n"
      "⚡ Flash: " + (useFlash ? "ON" : "OFF") + "\n"
      "🔖 Trigger: " + triggerLabel;
    tgEnqueuePhoto(path, cap);
  }
  return ok;
}

// ============================================================
//  AVI WRITER
// ============================================================
static void writeU32LE(File& f, uint32_t v) {
  uint8_t b[4]={(uint8_t)v,(uint8_t)(v>>8),(uint8_t)(v>>16),(uint8_t)(v>>24)};
  f.write(b,4);
}
static void writeTag(File& f, const char* t){ f.write((const uint8_t*)t,4); }

// Extract actual pixel dimensions from a JPEG frame by scanning for SOF marker.
// This is the only reliable way to know the true frame size - the camera
// config framesize_t gives nominal sizes, but the actual JPEG may differ.
// OPT: Limit scan to first 512 bytes. In a well-formed OV2640 JPEG the SOF
// marker (FF C0/C2) appears within the first ~200 bytes after APP0/APP1.
// Scanning the full frame (10-30KB) risked hitting 0xFF bytes in pixel data.
static bool jpegGetDimensions(const uint8_t* buf, size_t len, int& w, int& h) {
  size_t scanLen = (len < 512) ? len : 512;
  for (size_t i = 0; i + 8 < scanLen; i++) {
    if (buf[i] == 0xFF && (buf[i+1] == 0xC0 || buf[i+1] == 0xC2)) {
      // SOF marker: FF C0/C2 <length(2)> <precision(1)> <height(2)> <width(2)>
      h = (buf[i+5] << 8) | buf[i+6];
      w = (buf[i+7] << 8) | buf[i+8];
      if (w > 0 && h > 0) return true;
    }
  }
  // Fallback: scan full frame if not found in header (non-standard JPEG)
  for (size_t i = 512; i + 8 < len; i++) {
    if (buf[i] == 0xFF && (buf[i+1] == 0xC0 || buf[i+1] == 0xC2)) {
      h = (buf[i+5] << 8) | buf[i+6];
      w = (buf[i+7] << 8) | buf[i+8];
      if (w > 0 && h > 0) return true;
    }
  }
  return false;
}

static void patchAVIHeader(File& f, int frames, int fps, int w, int h) {
  f.seek(0);
  if(fps<1)fps=1; if(fps>30)fps=30;
  uint32_t usf = 1000000u / (uint32_t)fps;
  const uint32_t avihSz=56, strhSz=56, strfSz=40;
  uint32_t strlBody = 4 + (4+4+strhSz) + (4+4+strfSz);
  uint32_t hdrlBody = 4 + (4+4+avihSz) + (4+4+strlBody);
  uint32_t maxBytes = (uint32_t)w * h * 3;

  // RIFF AVI header
  writeTag(f,"RIFF"); writeU32LE(f,(uint32_t)f.size()-8); writeTag(f,"AVI ");

  // hdrl LIST
  writeTag(f,"LIST"); writeU32LE(f,hdrlBody); writeTag(f,"hdrl");

  // avih - Main AVI header (56 bytes)
  writeTag(f,"avih"); writeU32LE(f,avihSz);
  writeU32LE(f,usf);          // dwMicroSecPerFrame
  writeU32LE(f,maxBytes);     // dwMaxBytesPerSec
  writeU32LE(f,0);            // dwPaddingGranularity
  writeU32LE(f,0x00);         // dwFlags: 0 (no idx1 chunk written, so AVIF_HASINDEX must NOT be set)
  writeU32LE(f,(uint32_t)frames); // dwTotalFrames
  writeU32LE(f,0);            // dwInitialFrames
  writeU32LE(f,1);            // dwStreams
  writeU32LE(f,maxBytes);     // dwSuggestedBufferSize
  writeU32LE(f,(uint32_t)w);  // dwWidth
  writeU32LE(f,(uint32_t)h);  // dwHeight
  for(int i=0;i<4;i++) writeU32LE(f,0); // reserved[4]

  // strl LIST (stream list)
  writeTag(f,"LIST"); writeU32LE(f,strlBody); writeTag(f,"strl");

  // strh - Stream header (56 bytes)
  writeTag(f,"strh"); writeU32LE(f,strhSz);
  writeTag(f,"vids");         // fccType: video stream
  writeTag(f,"MJPG");         // fccHandler: MJPEG codec
  writeU32LE(f,0);            // dwFlags
  writeU32LE(f,0);            // wPriority + wLanguage
  writeU32LE(f,0);            // dwInitialFrames
  writeU32LE(f,1);            // dwScale (time base numerator)
  writeU32LE(f,(uint32_t)fps);// dwRate  (frames per second)
  writeU32LE(f,0);            // dwStart
  writeU32LE(f,(uint32_t)frames); // dwLength
  writeU32LE(f,maxBytes);     // dwSuggestedBufferSize
  writeU32LE(f,0xFFFFFFFF);   // dwQuality (-1 = default)
  writeU32LE(f,0);            // dwSampleSize (0 = variable)
  // rcFrame: {left=0, top=0, right=w, bottom=h} as two 32-bit LE words
  writeU32LE(f,0);                          // left(16) | top(16)
  writeU32LE(f,((uint32_t)h<<16)|(uint32_t)w); // right(16) | bottom(16) -- actually bottom(16)|right(16)

  // strf - BITMAPINFOHEADER (40 bytes) for MJPEG video stream
  writeTag(f,"strf"); writeU32LE(f,strfSz);
  writeU32LE(f,strfSz);            // biSize
  writeU32LE(f,(uint32_t)w);       // biWidth
  // biHeight: NEGATIVE value signals top-down row order (required for MJPEG).
  // Without this, many players assume bottom-up and display incorrectly.
  // Store as two's complement uint32.
  writeU32LE(f,(uint32_t)(-(int32_t)h)); // biHeight (negative = top-down)
  writeU32LE(f,1u|(24u<<16));      // biPlanes=1, biBitCount=24
  writeTag(f,"MJPG");              // biCompression
  writeU32LE(f,maxBytes);          // biSizeImage
  writeU32LE(f,0);                 // biXPelsPerMeter
  writeU32LE(f,0);                 // biYPelsPerMeter
  writeU32LE(f,0);                 // biClrUsed
  writeU32LE(f,0);                 // biClrImportant
}

#define AVI_HDR_RESERVE 256
bool startAVIRecording(int durationSec) {
  if(aviRecording) return false;
  // Check free space: estimate ~150 MB max for a 120s recording; require at least 200 MB free
  uint64_t freeBytes = SD_MMC.totalBytes() - SD_MMC.usedBytes();
  if (freeBytes < 200ULL * 1024 * 1024) {
    Serial.printf("[AVI] Insufficient SD space: %.0f MB free\n", freeBytes / 1048576.0f);
    tgSend("SD card almost full - recording aborted. Free space: "
      + String((uint32_t)(freeBytes / 1048576)) + " MB");
    return false;
  }
  if (sdMutex) xSemaphoreTake(sdMutex, portMAX_DELAY);
  SD_MMC.mkdir("/videos");
  // Filename: YYYY-MM-DD_HH-MM-SS_<RES>_<DUR>s.avi
  String path = "/videos/" + getTimestamp() + "_" + getResLabel(streamFrameSize)
                + "_" + String(durationSec) + "s.avi";
  strncpy(aviFilePath, path.c_str(), sizeof(aviFilePath)-1);
  aviFile = SD_MMC.open(aviFilePath, FILE_WRITE);
  if(!aviFile){ if(sdMutex) xSemaphoreGive(sdMutex); Serial.println("[AVI] Open failed"); return false; }
  uint8_t zeros[AVI_HDR_RESERVE]={};
  aviFile.write(zeros, AVI_HDR_RESERVE);
  aviMoviOffset = (uint32_t)aviFile.position();
  writeTag(aviFile,"LIST"); writeU32LE(aviFile,0); writeTag(aviFile,"movi");
  aviFrameCount = 0; aviStartMs = millis(); aviRecording = true;
  aviWidth = 640; aviHeight = 480;  // defaults - updated from first real frame
  Serial.printf("[AVI] Start %s\n", aviFilePath);
  return true;
}

bool addAVIFrame(camera_fb_t* fb){
  if(!aviRecording||!fb||aviFrameCount>=AVI_MAX_FRAMES) return false;
  // Extract actual frame dimensions from first frame
  if(aviFrameCount == 0) {
    int fw=0, fh=0;
    if(jpegGetDimensions(fb->buf, fb->len, fw, fh) && fw>0 && fh>0) {
      aviWidth = fw; aviHeight = fh;
      Serial.printf("[AVI] Frame dims from JPEG: %dx%d\n", fw, fh);
    }
  }
  aviFrameCount++;
  writeTag(aviFile,"00dc"); writeU32LE(aviFile,fb->len);
  aviFile.write(fb->buf,fb->len);
  if(fb->len&1) aviFile.write((uint8_t)0);
  return true;
}

String finishAVIRecording(){
  if(!aviRecording) return "";
  aviRecording=false;
  unsigned long dur=millis()-aviStartMs;
  int fps=(dur>0)?(int)((aviFrameCount*1000UL)/dur):5;
  if(fps<1)fps=1; if(fps>30)fps=30;
  uint32_t end=(uint32_t)aviFile.size();
  uint32_t moviBody=end-aviMoviOffset-8;
  aviFile.seek(aviMoviOffset+4); writeU32LE(aviFile,moviBody+4);
  // Use actual detected dimensions - correct aspect ratio in any player
  patchAVIHeader(aviFile, aviFrameCount, fps, aviWidth, aviHeight);
  aviFile.close();
  if (sdMutex) xSemaphoreGive(sdMutex);
  videoCount++;  // increment in-place; full rescan only at boot / deleteAllSD()
  Serial.printf("[AVI] Done %d frames %dfps %dx%d\n",
    aviFrameCount, fps, aviWidth, aviHeight);
  return String(aviFilePath);
}

// ============================================================
//  MOTION DETECTION  - v2.2 complete rewrite
//
//  Algorithm: Mean Absolute Difference (MAD) on grayscale frames
//
//  Why MAD works better than pixel-count:
//    ? JPEG noise causes tiny random differences on EVERY pixel
//    ? Counting "pixels > threshold" catches ALL of them ? floods
//    ? MAD averages all differences ? JPEG noise averages to ~0-3
//    ? Real motion creates large per-pixel differences ? MAD spikes
//
//  Extra guards:
//    1. Warm-up: first MD_WARMUP_FRAMES frames after arming are
//       discarded so the sensor and AE settle (eliminates boot floods)
//    2. Consecutive: motion fires only after MD_CONSEC_REQUIRED
//       successive frames both exceed the threshold (eliminates
//       single-frame compression artefact triggers)
// ============================================================

// Decode JPEG to grayscale at 1/8 scale -> 80x60
// Uses jpg2rgb565 then converts RGB565->gray via a precomputed LUT.
//
// OPT: Two 256-entry lookup tables replace the per-pixel multiply chain.
//   hiLUT[hi] = R contribution + upper-G contribution to BT.601 luma
//   loLUT[lo] = lower-G contribution + B contribution to BT.601 luma
//   luma = clamp(hiLUT[hi] + loLUT[lo], 255)
// Cost per pixel: 2 table lookups + 1 add  (was: 6 shifts, 4 ORs, 3 muls)
// ~40% faster on Xtensa LX6 at 240 MHz.
static bool     grayLUTReady = false;
static uint8_t  hiLUT[256];   // R + upper-G luma contribution indexed by hi byte
static uint8_t  loLUT[256];   // lower-G + B luma contribution indexed by lo byte

static void buildGrayLUT() {
  if (grayLUTReady) return;
  // hi byte layout: RRRRRGGG  (R5 in bits[7:3], G_hi3 in bits[2:0])
  for (int hi = 0; hi < 256; hi++) {
    uint8_t r5  = (hi >> 3) & 0x1F;
    uint8_t gh3 = hi & 0x07;             // top 3 bits of G6
    uint8_t r8  = (r5 << 3) | (r5 >> 2);
    uint8_t g6h = gh3 << 3;              // bottom 3 G bits contributed by loLUT
    uint8_t g8h = (g6h << 2) | (g6h >> 4);
    uint16_t v  = (77u * r8 + 150u * g8h) >> 8;
    hiLUT[hi]   = (uint8_t)(v > 255 ? 255 : v);
  }
  // lo byte layout: GGGBBBBB  (G_lo3 in bits[7:5], B5 in bits[4:0])
  for (int lo = 0; lo < 256; lo++) {
    uint8_t gl3 = (lo >> 5) & 0x07;     // bottom 3 bits of G6
    uint8_t b5  = lo & 0x1F;
    uint8_t b8  = (b5 << 3) | (b5 >> 2);
    uint8_t g6l = gl3;
    uint8_t g8l = (g6l << 2) | (g6l >> 4);
    uint16_t v  = (150u * g8l + 29u * b8) >> 8;
    loLUT[lo]   = (uint8_t)(v > 255 ? 255 : v);
  }
  grayLUTReady = true;
}

static bool decodeToGray(camera_fb_t* fb, uint8_t* grayOut) {
  static uint8_t* rgb565Tmp = nullptr;
  const size_t tmpSz = MD_PIXELS * 2;

  if (!rgb565Tmp) {
    rgb565Tmp = psramFound()
      ? (uint8_t*)ps_malloc(tmpSz)
      : (uint8_t*)malloc(tmpSz);
    if (!rgb565Tmp) {
      Serial.println("[MD] decodeToGray: buffer alloc failed - motion disabled");
      return false;
    }
  }

  buildGrayLUT();  // no-op after first call

  if (!jpg2rgb565(fb->buf, fb->len, rgb565Tmp, JPG_SCALE_8X)) return false;

  // OPT: LUT lookup - 2 reads + 1 add per pixel replaces full multiply chain
  const uint8_t* src = rgb565Tmp;
  for (int i = 0; i < MD_PIXELS; i++) {
    uint16_t luma = (uint16_t)hiLUT[src[0]] + (uint16_t)loLUT[src[1]];
    grayOut[i] = (luma > 255) ? 255 : (uint8_t)luma;
    src += 2;
  }
  return true;
}

bool checkMotion(camera_fb_t* fb) {
  // Guard: armed, buffers ready, not recording
  if (!motionArmed || !prevGray || !currGray) return false;

  // Decode current frame to grayscale
  if (!decodeToGray(fb, currGray)) return false;

  // Warm-up phase: accumulate baseline frames, don't trigger.
  // OPT: Only memcpy on the LAST warm-up frame - previous copies were
  // immediately overwritten by the next frame's decode, so they were wasted.
  if (!mdWarmedUp) {
    mdWarmupCount++;
    if (mdWarmupCount >= MD_WARMUP_FRAMES) {
      // Final warm-up frame: latch it as the baseline and go active
      memcpy(prevGray, currGray, MD_PIXELS);
      prevFrameReady = true;
      mdWarmedUp = true;
      Serial.println("[MD] Warm-up complete - detection active");
    } else {
      Serial.printf("[MD] Warm-up %d/%d\n", mdWarmupCount, MD_WARMUP_FRAMES);
    }
    return false;
  }

  if (!prevFrameReady) {
    memcpy(prevGray, currGray, MD_PIXELS);
    prevFrameReady = true;
    return false;
  }

  // Compute Mean Absolute Difference across all pixels
  uint32_t sumDiff = 0;
  for (int i = 0; i < MD_PIXELS; i++) {
    sumDiff += (uint32_t)abs((int)currGray[i] - (int)prevGray[i]);
  }
  float mad = (float)sumDiff / MD_PIXELS;

  // Update previous frame
  memcpy(prevGray, currGray, MD_PIXELS);

  // Throttle serial output: print idle MAD at most once every 5 seconds
  static unsigned long lastMadPrintMs = 0;
  if (millis() - lastMadPrintMs >= 5000) {
    Serial.printf("[MD] MAD=%.2f threshold=%.2f\n", mad, mdThreshold);
    lastMadPrintMs = millis();
  }

  // Check against threshold
  if (mad > mdThreshold) {
    mdConsecutive++;
    Serial.printf("[MD] Hit %d/%d (MAD=%.2f)\n",
      mdConsecutive, MD_CONSEC_REQUIRED, mad);
    if (mdConsecutive >= MD_CONSEC_REQUIRED) {
      mdConsecutive = 0;   // reset for next event
      return true;         // REAL MOTION CONFIRMED
    }
  } else {
    // Reset consecutive counter if frame is calm
    mdConsecutive = 0;
  }
  return false;
}

// ============================================================
//  MJPEG STREAM SERVER  (port 81)
// ============================================================
#define STREAM_BD "ESP32SBound"
static const char* STREAM_CT   = "multipart/x-mixed-replace;boundary=" STREAM_BD;
// X-Timestamp matches CameraWebServer format - some clients use it for sync
static const char* STREAM_PART = "Content-Type: image/jpeg\r\nContent-Length: %u\r\nX-Timestamp: %d.%06d\r\n\r\n";

static esp_err_t streamHandler(httpd_req_t* req) {
  if (!streamActive) { httpd_resp_send_404(req); return ESP_OK; }
  httpd_resp_set_type(req, STREAM_CT);
  httpd_resp_set_hdr(req, "Access-Control-Allow-Origin", "*");
  httpd_resp_set_hdr(req, "X-Framerate", "60");
  const char* bnd = "\r\n--" STREAM_BD "\r\n";
  char hdr[128];  // enlarged to fit X-Timestamp

  int64_t frameIntervalUs = (streamFps > 0) ? (1000000 / streamFps) : 100000;
  int64_t lastFrameUs = esp_timer_get_time();

  while (streamActive) {
    camera_fb_t* fb = esp_camera_fb_get();
    if (!fb) break;
    httpd_resp_send_chunk(req, bnd, strlen(bnd));
    size_t hl = snprintf(hdr, sizeof(hdr), STREAM_PART, fb->len,
                         (int)fb->timestamp.tv_sec, (int)fb->timestamp.tv_usec);
    httpd_resp_send_chunk(req, hdr, hl);
    esp_err_t r = httpd_resp_send_chunk(req, (const char*)fb->buf, fb->len);
    esp_camera_fb_return(fb);
    if (r != ESP_OK) break;
    int64_t now = esp_timer_get_time();
    int64_t elapsed = now - lastFrameUs;
    if (elapsed < frameIntervalUs) {
      vTaskDelay(pdMS_TO_TICKS((frameIntervalUs - elapsed) / 1000));
    }
    lastFrameUs = esp_timer_get_time();
  }
  return ESP_OK;
}

void startStreamServer() {
  httpd_config_t cfg = HTTPD_DEFAULT_CONFIG();
  cfg.server_port    = 81;
  cfg.ctrl_port      = 32769;
  cfg.max_uri_handlers = 2;
  cfg.stack_size     = 8192;   // CameraWebServer uses 8KB stack for stream task
  cfg.send_wait_timeout = 10;  // seconds - prevents slow clients from blocking
  httpd_uri_t u = {"/stream", HTTP_GET, streamHandler, nullptr};
  if (httpd_start(&streamHttpd, &cfg) == ESP_OK) {
    httpd_register_uri_handler(streamHttpd, &u);
    Serial.println("[STREAM] :81/stream ready");
  }
}

// ============================================================
//  WEB SERVER  (port 80)
// ============================================================
void apiStatus() {
  float temp = temperatureRead();
  const char* rl[] = {
    "96x96","QQVGA","QCIF","HQVGA","240x240","QVGA 320x240","CIF 400x296",
    "HVGA 480x320","VGA 640x480","SVGA 800x600","XGA 1024x768",
    "HD 1280x720","SXGA 1280x1024","UXGA 1600x1200"
  };
  String resLabel = (streamFrameSize>=0&&streamFrameSize<=13) ? rl[streamFrameSize] : "VGA 640x480";
  StaticJsonDocument<640> doc;
  doc["uptime"]       = getUptime();
  doc["wifi"]         = (WiFi.status()==WL_CONNECTED);
  doc["ip"]           = WiFi.localIP().toString();
  doc["rssi"]         = WiFi.RSSI();
  doc["temp"]         = String(temp,1);
  doc["resolution"]   = resLabel + " @" + String(streamFps) + "fps";
  doc["streamRes"]    = streamFrameSize;
  doc["streamFps"]    = streamFps;
  doc["photos"]       = photoCount;
  doc["videos"]       = videoCount;
  doc["armed"]        = motionArmed;
  doc["warmedUp"]     = mdWarmedUp;
  doc["sensitivity"]  = motionSensitivity;
  doc["cooldown"]     = motionCooldownS;
  doc["recording"]    = aviRecording;
  doc["telegram"]     = telegramEnabled;
  doc["timelapse"]    = timelapseActive;
  doc["tlInterval"]   = timelapseIntervalS;
  doc["emailEnabled"] = emailEnabled;
  doc["freeHeap"]     = (uint32_t)(ESP.getFreeHeap()/1024);
  doc["freePsram"]    = (uint32_t)(ESP.getFreePsram()/1024);
  String out; serializeJson(doc,out);
  webServer.send(200,"application/json",out);
}

// ============================================================
//  /api/sdstats -- SD FAT queries on user demand only
// ============================================================
void apiSdStats() {
  uint64_t tot=SD_MMC.totalBytes(), used=SD_MMC.usedBytes();
  String t="Unknown";
  switch(SD_MMC.cardType()){
    case CARD_MMC:  t="MMC";        break;
    case CARD_SD:   t="SDSC";       break;
    case CARD_SDHC: t="SDHC/SDXC"; break;
    default: break;
  }
  StaticJsonDocument<192> doc;
  doc["sdType"]  = t;
  doc["sdTotal"] = (uint32_t)(tot/1048576);
  doc["sdUsed"]  = (uint32_t)(used/1048576);
  doc["sdFree"]  = (uint32_t)((tot-used)/1048576);
  String out; serializeJson(doc,out);
  webServer.send(200,"application/json",out);
}


// NEW: dedicated motion arm/disarm endpoint
void apiMotion() {
  if (webServer.hasArg("armed")) {
    int v = webServer.arg("armed").toInt();
    if (v) armMotion(); else disarmMotion();
  }
  webServer.send(200,"application/json",
    String("{\"armed\":")+( motionArmed?"true":"false")+"}");
}

// GET /api/timelapse?active=1&interval=30
void apiTimelapse() {
  if (webServer.hasArg("active")) {
    timelapseActive = webServer.arg("active").toInt() != 0;
    if (timelapseActive) lastTimelapseMs = 0; // fire first capture immediately
    Serial.printf("[TL] Timelapse %s\n", timelapseActive ? "STARTED" : "STOPPED");
  }
  if (webServer.hasArg("interval")) {
    timelapseIntervalS = constrain(webServer.arg("interval").toInt(), 1, 3600);
    Serial.printf("[TL] Interval set to %ds\n", timelapseIntervalS);
  }
  // Persist across reboot
  preferences.begin("surveil", false);
  preferences.putBool("tlActive",   timelapseActive);
  preferences.putInt ("tlInterval", timelapseIntervalS);
  preferences.end();
  webServer.send(200,"application/json",
    String("{\"active\":") + (timelapseActive?"true":"false") +
    ",\"interval\":" + String(timelapseIntervalS) + "}");
}

// Photo handler: schedule work in loop() and return immediately.
// captureAndSavePhoto() takes ~2s - we must not block handleClient().
void apiPhoto() {
  if (pendingJob.type != JOB_NONE) {
    webServer.send(503,"application/json","{\"ok\":false,\"error\":\"Busy\"}"); return;
  }
  pendingJob.flash = webServer.hasArg("flash") && webServer.arg("flash") == "1";
  pendingJob.type  = JOB_PHOTO;
  webServer.send(200,"application/json","{\"ok\":true,\"queued\":true}");
}

void apiStreamStart() {
  // Accept optional res/fps overrides from the start request
  if (webServer.hasArg("res")) {
    int r = webServer.arg("res").toInt();
    if (r >= 0 && r <= 13) { streamFrameSize = r; }
  }
  if (webServer.hasArg("fps")) {
    int f = webServer.arg("fps").toInt();
    if (f >= 1 && f <= 30) { streamFps = f; }
  }
  // Stop stream while we reinit camera (safe - nothing streaming yet)
  streamActive = false;
  delay(100);
  applyStreamResolution();
  delay(150);
  streamActive = true;
  webServer.send(200,"application/json","{\"ok\":true}");
}
void apiStreamStop() {
  streamActive = false;
  delay(150);   // let stream handler exit its loop
  webServer.send(200,"application/json","{\"ok\":true}");
}

void apiStreamQuality() {
  bool wasStreaming = streamActive;
  // Stop stream before changing resolution
  if (wasStreaming) {
    streamActive = false;
    delay(200);   // let httpd task finish current frame
  }
  if (webServer.hasArg("res")) {
    int r = webServer.arg("res").toInt();
    if (r >= 0 && r <= 13) { streamFrameSize = r; }
  }
  if (webServer.hasArg("fps")) {
    int f = webServer.arg("fps").toInt();
    if (f >= 1 && f <= 30) { streamFps = f; }
  }
  // Reinit camera at new resolution
  applyStreamResolution();
  delay(100);
  if (wasStreaming) { streamActive = true; }
  webServer.send(200,"application/json","{\"ok\":true}");
}

void apiRestart() {
  webServer.send(200,"application/json","{\"ok\":true}");
  delay(300);
  ESP.restart();
}

// Record handler: schedule work in loop() and return immediately.
// Recording takes 5-120s - blocking handleClient() would freeze dashboard.
void apiRecord(){
  int secs=webServer.hasArg("secs")?webServer.arg("secs").toInt():10;
  secs=constrain(secs,5,120);
  if(aviRecording||pendingJob.type!=JOB_NONE){
    webServer.send(200,"application/json","{\"ok\":false,\"error\":\"Busy\"}"); return;
  }
  pendingJob.recSecs = secs;
  pendingJob.type    = JOB_RECORD;
  webServer.send(200,"application/json","{\"ok\":true,\"queued\":true,\"secs\":"+String(secs)+"}");
}

// OPT: Cached file list - rebuilt only when photoCount or videoCount changes.
// The SD directory scan + sort is O(n log n) flash I/O; for typical use the
// file list is stable between captures so we serve the cached result.
struct FileEntry { char name[64]; char path[96]; size_t size; };
static std::vector<FileEntry> eventsCache;

static void rebuildEventsCache() {
  eventsCache.clear();
  eventsCache.reserve(64);
  auto scanDir = [](const char* dir) {
    File root = SD_MMC.open(dir);
    if (!root || !root.isDirectory()) return;
    File f = root.openNextFile();
    while (f) {
      if (!f.isDirectory()) {
        FileEntry e;
        strlcpy(e.name, f.name(),    sizeof(e.name));
        snprintf(e.path, sizeof(e.path), "%s/%s", dir, f.name());
        e.size = f.size();
        eventsCache.push_back(e);
      }
      f = root.openNextFile();
    }
    root.close();
  };
  scanDir("/photos");
  scanDir("/videos");
  std::sort(eventsCache.begin(), eventsCache.end(),
    [](const FileEntry& a, const FileEntry& b){ return strcmp(a.name, b.name) > 0; });
  eventsCachePhotoSnap = photoCount;
  eventsCacheVideoSnap = videoCount;
  eventsCacheDirty     = false;
}

void apiEvents(){
  int offset = webServer.hasArg("offset") ? webServer.arg("offset").toInt() : 0;
  int limit  = webServer.hasArg("limit")  ? webServer.arg("limit").toInt()  : EVENTS_PAGE_SIZE;
  limit = constrain(limit, 1, 100);

  // OPT: Only rescan SD when the file list has changed (dirty flag or count mismatch).
  if (eventsCacheDirty ||
      photoCount != eventsCachePhotoSnap ||
      videoCount != eventsCacheVideoSnap) {
    rebuildEventsCache();
  }

  int total = (int)eventsCache.size();
  DynamicJsonDocument doc(8192);
  doc["total"] = total;
  JsonArray arr = doc.createNestedArray("files");

  int end = min(offset + limit, total);
  for (int i = offset; i < end; i++) {
    JsonObject o = arr.createNestedObject();
    o["name"] = eventsCache[i].name;
    o["path"] = eventsCache[i].path;
    o["size"] = String(eventsCache[i].size / 1024) + " KB";
  }
  String out; serializeJson(doc, out);
  webServer.send(200, "application/json", out);
}

void apiDeleteAll() {
  int before = photoCount + videoCount;  // capture before deleteAllSD() resets counters
  deleteAllSD();
  eventsCacheDirty = true;  // OPT: force events cache rebuild after mass delete
  webServer.send(200, "application/json",
    "{\"ok\":true,\"count\":" + String(before) + "}");
}

void apiDownload(){
  if(!webServer.hasArg("f")){webServer.send(400,"text/plain","Missing f");return;}
  String path=webServer.arg("f");
  if(!path.startsWith("/photos/")&&!path.startsWith("/videos/")){webServer.send(403,"text/plain","Forbidden");return;}
  File f=SD_MMC.open(path.c_str(),FILE_READ);
  if(!f){webServer.send(404,"text/plain","Not found");return;}
  bool jpg=path.endsWith(".jpg")||path.endsWith(".jpeg");
  webServer.sendHeader("Content-Disposition","attachment; filename=\""+path.substring(path.lastIndexOf('/')+1)+"\"");
  webServer.streamFile(f,jpg?"image/jpeg":"video/x-msvideo"); f.close();
}
void apiThumb(){
  if(!webServer.hasArg("f")){webServer.send(404,"text/plain","No f");return;}
  String path=webServer.arg("f");
  if(!path.startsWith("/photos/")){webServer.send(403,"text/plain","Forbidden");return;}
  File f=SD_MMC.open(path.c_str(),FILE_READ);
  if(!f){webServer.send(404,"text/plain","Not found");return;}
  webServer.streamFile(f,"image/jpeg"); f.close();
}
void apiDelete(){
  if(!webServer.hasArg("f")){webServer.send(400,"application/json","{\"ok\":false}");return;}
  String path=webServer.arg("f");
  if(!path.startsWith("/photos/")&&!path.startsWith("/videos/")){webServer.send(403,"application/json","{\"ok\":false}");return;}
  bool ok=SD_MMC.remove(path.c_str());
  if(ok){
    if(path.startsWith("/photos/")) photoCount = max(0, photoCount - 1);
    else                            videoCount = max(0, videoCount - 1);
  }
  webServer.send(200,"application/json",ok?"{\"ok\":true}":"{\"ok\":false,\"error\":\"Delete failed\"}");
}
void apiConfig(){
  if(webServer.method()==HTTP_POST){
    StaticJsonDocument<768> doc;
    if(deserializeJson(doc,webServer.arg("plain"))){
      webServer.send(400,"application/json","{\"ok\":false}"); return;
    }
    bool needReboot = false;
    // Update in-RAM values immediately (these are used by the running system)
    if(doc.containsKey("sensitivity")){
      motionSensitivity=(int)doc["sensitivity"];
      mdThreshold=sliderToThreshold(motionSensitivity);
    }
    if(doc.containsKey("cooldown")){
      motionCooldownS=(int)doc["cooldown"];
    }
    if(doc.containsKey("wifiSSID")) needReboot=true;
    if(doc.containsKey("wifiPass")) needReboot=true;
    if(doc.containsKey("botToken")) needReboot=true;
    if(doc.containsKey("chatID"))   needReboot=true;
    // OPT: Send HTTP response BEFORE NVS flash writes.
    // Client gets its 200 OK instantly; NVS erase/write (~5-15ms per key)
    // happens after the TCP stack has queued the response bytes.
    // OPT: Single preferences.begin()/end() for all keys (was one open/close per key).
    webServer.send(200,"application/json",
      needReboot ? "{\"ok\":true,\"reboot\":true}" : "{\"ok\":true,\"reboot\":false}");
    preferences.begin("surveil", false);
    if(doc.containsKey("sensitivity")) preferences.putInt("motionSens", motionSensitivity);
    if(doc.containsKey("cooldown"))    preferences.putInt("motionCool", motionCooldownS);
    if(doc.containsKey("wifiSSID"))    preferences.putString("wifiSSID", doc["wifiSSID"].as<String>());
    if(doc.containsKey("wifiPass"))    preferences.putString("wifiPass", doc["wifiPass"].as<String>());
    if(doc.containsKey("botToken"))    preferences.putString("botToken", doc["botToken"].as<String>());
    if(doc.containsKey("chatID"))      preferences.putString("chatID",   doc["chatID"].as<String>());
    preferences.end();
    if(needReboot){ delay(800); ESP.restart(); }
  } else {
    StaticJsonDocument<512> doc;
    doc["sensitivity"]  = motionSensitivity;
    doc["cooldown"]     = motionCooldownS;
    preferences.begin("surveil", true);
    doc["wifiSSID"]     = preferences.getString("wifiSSID","");
    doc["tgConfigured"] = (preferences.getString("botToken","").length() > 0);
    preferences.end();
    doc["apMode"]       = apMode;
    String out; serializeJson(doc,out);
    webServer.send(200,"application/json",out);
  }
}


// ============================================================
//  CAMERA CONTROL - exact CameraWebServer approach
//  GET /control?var=brightness&val=2
//  One request per variable, direct sensor register write.
//  No JSON, no mutex, no stream stop. Works exactly like the
//  official Espressif CameraWebServer example.
// ============================================================
void apiCamControl() {
  if (!webServer.hasArg("var") || !webServer.hasArg("val")) {
    webServer.send(400, "text/plain", "Missing var or val"); return;
  }
  String var = webServer.arg("var");
  int    val = webServer.arg("val").toInt();
  sensor_t* s = esp_camera_sensor_get();
  if (!s) { webServer.send(500, "text/plain", "No sensor"); return; }

  int res = 0;
  if      (var == "framesize")     { if (s->pixformat == PIXFORMAT_JPEG) res = s->set_framesize(s, (framesize_t)val); }
  else if (var == "quality")       res = s->set_quality(s, val);
  else if (var == "contrast")      res = s->set_contrast(s, val);
  else if (var == "brightness")    res = s->set_brightness(s, val);
  else if (var == "saturation")    res = s->set_saturation(s, val);
  else if (var == "gainceiling")   res = s->set_gainceiling(s, (gainceiling_t)val);
  else if (var == "colorbar")      res = s->set_colorbar(s, val);
  else if (var == "awb")           res = s->set_whitebal(s, val);
  else if (var == "agc")           res = s->set_gain_ctrl(s, val);
  else if (var == "aec")           res = s->set_exposure_ctrl(s, val);
  else if (var == "hmirror")       res = s->set_hmirror(s, val);
  else if (var == "vflip")         res = s->set_vflip(s, val);
  else if (var == "awb_gain")      res = s->set_awb_gain(s, val);
  else if (var == "agc_gain")      res = s->set_agc_gain(s, val);
  else if (var == "aec_value")     res = s->set_aec_value(s, val);
  else if (var == "aec2")          res = s->set_aec2(s, val);
  else if (var == "dcw")           res = s->set_dcw(s, val);
  else if (var == "bpc")           res = s->set_bpc(s, val);
  else if (var == "wpc")           res = s->set_wpc(s, val);
  else if (var == "raw_gma")       res = s->set_raw_gma(s, val);
  else if (var == "lenc")          res = s->set_lenc(s, val);
  else if (var == "special_effect")res = s->set_special_effect(s, val);
  else if (var == "wb_mode")       res = s->set_wb_mode(s, val);
  else if (var == "ae_level")      res = s->set_ae_level(s, val);
  else if (var == "sharpness")     res = s->set_sharpness(s, val);
  else if (var == "led_intensity") {
    // LED intensity via LEDC PWM - same as CameraWebServer enable_led().
    // ledcWrite(pin, 0) fully cuts PWM output; no digitalWrite needed.
    ledDuty = constrain(val, 0, 255);
    ledcWrite(FLASH_LED_PIN, ledDuty);
    Serial.printf("[CAM] control: led_intensity = %d\n", ledDuty);
    webServer.send(200, "text/plain", "OK"); return;
  }
  else { webServer.send(404, "text/plain", "Unknown var"); return; }

  Serial.printf("[CAM] control: %s = %d (res=%d)\n", var.c_str(), val, res);
  if (res < 0) { webServer.send(500, "text/plain", "Sensor error"); return; }
  webServer.send(200, "text/plain", "OK");
}

// GET /xclk?xclk=20 - set XCLK frequency in MHz, same as CameraWebServer
void apiXclk() {
  if (!webServer.hasArg("xclk")) { webServer.send(400, "text/plain", "Missing xclk"); return; }
  int xclk = webServer.arg("xclk").toInt();
  xclk = constrain(xclk, 2, 40);
  sensor_t* s = esp_camera_sensor_get();
  if (!s) { webServer.send(500, "text/plain", "No sensor"); return; }
  int res = s->set_xclk(s, LEDC_TIMER_0, xclk);
  Serial.printf("[CAM] XCLK set to %d MHz (res=%d)\n", xclk, res);
  if (res != 0) { webServer.send(500, "text/plain", "XCLK error"); return; }
  webServer.send(200, "text/plain", "OK");
}

// GET /camstatus - reads actual sensor register values, same as CameraWebServer /status
// Dashboard calls this on load to populate all sliders with real current values.
void apiCamStatus() {
  sensor_t* s = esp_camera_sensor_get();
  if (!s) { webServer.send(500, "application/json", "{}"); return; }
  StaticJsonDocument<768> doc;
  doc["framesize"]      = s->status.framesize;
  doc["quality"]        = s->status.quality;
  doc["brightness"]     = s->status.brightness;
  doc["contrast"]       = s->status.contrast;
  doc["saturation"]     = s->status.saturation;
  doc["sharpness"]      = s->status.sharpness;
  doc["special_effect"] = s->status.special_effect;
  doc["wb_mode"]        = s->status.wb_mode;
  doc["awb"]            = s->status.awb;
  doc["awb_gain"]       = s->status.awb_gain;
  doc["aec"]            = s->status.aec;
  doc["aec2"]           = s->status.aec2;
  doc["ae_level"]       = s->status.ae_level;
  doc["aec_value"]      = s->status.aec_value;
  doc["agc"]            = s->status.agc;
  doc["agc_gain"]       = s->status.agc_gain;
  doc["gainceiling"]    = s->status.gainceiling;
  doc["bpc"]            = s->status.bpc;
  doc["wpc"]            = s->status.wpc;
  doc["raw_gma"]        = s->status.raw_gma;
  doc["lenc"]           = s->status.lenc;
  doc["hmirror"]        = s->status.hmirror;
  doc["vflip"]          = s->status.vflip;
  doc["dcw"]            = s->status.dcw;
  doc["colorbar"]       = s->status.colorbar;
  doc["xclk"]           = s->xclk_freq_hz / 1000000;  // MHz, matches CameraWebServer /status
  doc["led_intensity"]  = ledDuty;  // actual current PWM duty
  String out; serializeJson(doc, out);
  webServer.send(200, "application/json", out);
}

void initWebServer(){
  // Serve gzip-compressed dashboard (73% smaller than plain HTML)
  webServer.on("/",[](){ 
    webServer.sendHeader("Cache-Control","no-cache");
    webServer.sendHeader("Content-Encoding","gzip");
    webServer.send_P(200,"text/html",(const char*)DASHBOARD_HTML_GZ, DASHBOARD_HTML_GZ_LEN);
  });
  webServer.on("/api/status",          HTTP_GET,    apiStatus);
  webServer.on("/api/sdstats",         HTTP_GET,    apiSdStats);
  webServer.on("/api/photo",           HTTP_GET,    apiPhoto);
  webServer.on("/api/stream/start",    HTTP_GET,    apiStreamStart);
  webServer.on("/api/stream/stop",     HTTP_GET,    apiStreamStop);
  webServer.on("/api/stream/quality",  HTTP_GET,    apiStreamQuality);
  webServer.on("/api/motion",          HTTP_GET,    apiMotion);
  webServer.on("/api/timelapse",        HTTP_GET,    apiTimelapse);
  webServer.on("/api/record",          HTTP_GET,    apiRecord);
  webServer.on("/api/events",          HTTP_GET,    apiEvents);
  webServer.on("/api/download",        HTTP_GET,    apiDownload);
  webServer.on("/api/thumb",           HTTP_GET,    apiThumb);
  webServer.on("/api/delete",          HTTP_DELETE, apiDelete);
  webServer.on("/api/deleteall",       HTTP_DELETE, apiDeleteAll);
  webServer.on("/api/config",          HTTP_GET,    apiConfig);
  webServer.on("/api/config",          HTTP_POST,   apiConfig);
  webServer.on("/control",              HTTP_GET,    apiCamControl);  // CameraWebServer-compatible
  webServer.on("/camstatus",            HTTP_GET,    apiCamStatus);
  webServer.on("/xclk",                 HTTP_GET,    apiXclk);
  webServer.on("/api/restart",         HTTP_GET,    apiRestart);
  webServer.begin();
  Serial.println("[WEB] :80 ready");
}

// ============================================================
//  TELEGRAM COMMAND PROCESSOR
// ============================================================
void runTelegramRecord(int secs){
  tgSend("🎥 Starting "+String(secs)+"s "+getResLabel(streamFrameSize)+" recording...");
  if(!startAVIRecording(secs)){tgSend("? Could not start recording");return;}
  unsigned long dl=millis()+(unsigned long)(secs*1000);
  const unsigned long frameIntervalMs = 100;  // 10 fps - keeps file size manageable for Telegram upload
  while(millis()<dl){
    unsigned long frameStart = millis();
    camera_fb_t* fb=esp_camera_fb_get();
    if(fb){addAVIFrame(fb);esp_camera_fb_return(fb);}
    webServer.handleClient();
    unsigned long elapsed = millis() - frameStart;
    if (elapsed < frameIntervalMs) delay(frameIntervalMs - elapsed);
  }
  String path=finishAVIRecording();
  File vf=SD_MMC.open(path.c_str(),FILE_READ); uint32_t fsz=vf?vf.size():0; if(vf)vf.close();
  tgEnqueueVideo(path,
    "🎬 AVI Video recorded!\n"
    "📊 Stats:\n"
    "🎞 Frames: "+String(aviFrameCount)+"\n"
    "🎥 Resolution: "+String(aviWidth)+"x"+String(aviHeight)+"\n"
    "📁 Size: "+String(fsz/1024)+" KB\n"
    "⏱ Duration: "+String(secs)+"s\n"
    "💾 Saved to SD");
}


// ============================================================
//  SETUP
// ============================================================
// ============================================================
//  PENDING JOB EXECUTOR  (called from loop every iteration)
// ============================================================
void executePendingJob() {
  if (pendingJob.type == JOB_NONE) return;

  if (pendingJob.type == JOB_PHOTO) {
    pendingJob.type = JOB_NONE;  // clear before work so re-entrant calls see idle
    bool flash = pendingJob.flash;
    bool ok = captureAndSavePhoto(true, "Dashboard Button", flash);
    // Result is already sent via Telegram; /api/status reflects updated photoCount
    Serial.printf("[JOB] Photo done, ok=%d\n", (int)ok);
  }
  else if (pendingJob.type == JOB_RECORD) {
    int secs = pendingJob.recSecs;
    pendingJob.type = JOB_NONE;  // clear so motion/photo can run after record
    tgEnqueue("🎥 Starting "+String(secs)+"s "+getResLabel(streamFrameSize)+" recording...");
    if (!startAVIRecording(secs)) {
      tgEnqueue("Could not open file for recording");
      return;
    }
    unsigned long dl = millis() + (unsigned long)(secs * 1000);
    const unsigned long frameIntervalMs = 100;  // 10 fps - keeps file size manageable for Telegram upload
    while (millis() < dl) {
      unsigned long frameStart = millis();
      camera_fb_t* fb = esp_camera_fb_get();
      if (fb) { addAVIFrame(fb); esp_camera_fb_return(fb); }
      webServer.handleClient();  // keep web responsive during recording
      // Compensate for SD write + handleClient time to maintain even frame pacing
      unsigned long elapsed = millis() - frameStart;
      if (elapsed < frameIntervalMs) delay(frameIntervalMs - elapsed);
    }
    String path = finishAVIRecording();
    uint32_t fsz = 0;
    if (sdMutex) xSemaphoreTake(sdMutex, portMAX_DELAY);
    File vf = SD_MMC.open(path.c_str(), FILE_READ);
    fsz = vf ? vf.size() : 0; if (vf) vf.close();
    if (sdMutex) xSemaphoreGive(sdMutex);
    tgEnqueueVideo(path,
      "🎬 AVI Video recorded!\n"
      "📊 Stats:\n"
      "🎞 Frames: "+String(aviFrameCount)+"\n"
      "🎥 Resolution: "+String(aviWidth)+"x"+String(aviHeight)+"\n"
      "📁 Size: "+String(fsz/1024)+" KB\n"
      "⏱ Duration: "+String(secs)+"s\n"
      "💾 Saved to SD");
    Serial.printf("[JOB] Record done, %d frames\n", aviFrameCount);
  }
}

void setup(){
  WRITE_PERI_REG(RTC_CNTL_BROWN_OUT_REG,0);
  Serial.begin(115200); delay(1000);
  bootMs = millis();
  Serial.println("\n+======================================+");
  Serial.println("| ESP32-CAM Surveillance System v1.0  |");
  Serial.println("| Motion detection: OFF at boot        |");
  Serial.println("+======================================+");

  // Flash LED: use LEDC PWM so intensity slider works correctly.
  // ledcAttach replaces pinMode - same approach as CameraWebServer setupLedFlash().
  ledcAttach(FLASH_LED_PIN, FLASH_LEDC_FREQ, FLASH_LEDC_RES);
  ledcWrite(FLASH_LED_PIN, 0);  // start off

  preferences.begin("surveil", false);
  motionSensitivity  = preferences.getInt ("motionSens",  MOTION_SENSITIVITY_DEFAULT);
  motionCooldownS    = preferences.getInt ("motionCool",  MOTION_COOLDOWN_DEFAULT_S);
  mdThreshold        = sliderToThreshold(motionSensitivity);
  timelapseActive    = preferences.getBool("tlActive",    false);
  timelapseIntervalS = preferences.getInt ("tlInterval",  30);
  // Load credentials from NVS
  cfgWifiSSID = preferences.getString("wifiSSID", "");
  cfgWifiPass = preferences.getString("wifiPass", "");
  cfgBotToken = preferences.getString("botToken", "");
  cfgChatID   = preferences.getString("chatID",   "");
  preferences.end();  // close NVS namespace; reopen only when writing

  // Allocate motion detection buffers (grayscale only - 80x60 = 4800 bytes each)
  if(psramFound()){
    prevGray=(uint8_t*)ps_malloc(MD_PIXELS);
    currGray=(uint8_t*)ps_malloc(MD_PIXELS);
    Serial.println("[MD] PSRAM buffers OK");
  } else {
    prevGray=(uint8_t*)malloc(MD_PIXELS);
    currGray=(uint8_t*)malloc(MD_PIXELS);
    Serial.println("[MD] DRAM buffers OK");
  }
  if(!prevGray||!currGray) Serial.println("⚠ Motion buffer alloc failed");

  // Create SD mutex and Telegram queue/semaphore before any SD or WiFi use
  sdMutex  = xSemaphoreCreateMutex();
  tgBusySem = xSemaphoreCreateBinary();
  if (tgBusySem) xSemaphoreGive(tgBusySem);  // start in "not busy" state
  tgQueue  = xQueueCreate(4, sizeof(TgJob));
  if(!sdMutex || !tgQueue || !tgBusySem) Serial.println("[RTOS] Queue/Mutex/Sem alloc FAILED");

  if(!initCamera()){ Serial.println("[FATAL] Camera failed"); while(true) delay(1000); }

  if(!initSD()){
    Serial.println("⚠ No SD - media disabled");
  } else {
    SD_MMC.mkdir("/photos"); SD_MMC.mkdir("/videos");
    photoCount=countPhotos(); videoCount=countVideos();
    Serial.printf("[SD] %d photos, %d videos\n",photoCount,videoCount);
  }

  // Try STA mode if credentials exist
  if (cfgWifiSSID.length() > 0) {
    WiFi.mode(WIFI_STA);
    WiFi.begin(cfgWifiSSID.c_str(), cfgWifiPass.c_str());
    Serial.printf("[WiFi] Connecting to %s", cfgWifiSSID.c_str());
    for (int i = 0; i < 30 && WiFi.status() != WL_CONNECTED; i++) {
      delay(500); Serial.print(".");
    }
    Serial.println();
  }

  if (WiFi.status() == WL_CONNECTED) {
    apMode = false;
    Serial.println("[WiFi] Connected  IP: " + WiFi.localIP().toString());
    configTime(0, 0, NTP_SERVER);           // fetch UTC from NTP
    setenv("TZ", POSIX_TZ, 1);             // apply local timezone + DST rules
    tzset();
    delay(1500);
    // Init Telegram if credentials saved
    if (cfgBotToken.length() > 0 && cfgChatID.length() > 0) {
      telegramEnabled = true;
      securedClient.setCACert(TELEGRAM_CERTIFICATE_ROOT);
      bot = new UniversalTelegramBot(cfgBotToken.c_str(), securedClient);
      delay(2000);
      tgSend(
        "\xF0\x9F\x9A\x80 *Hellboy's WatchTower v1.0 Online!*\n\n"
        "\xF0\x9F\x93\xA1 IP: " + WiFi.localIP().toString() + "\n"
        "\xF0\x9F\x8F\xA0 Dashboard: http://" + WiFi.localIP().toString() + "\n"
        "\xF0\x9F\x93\xB6 WiFi: " + String(WiFi.RSSI()) + " dBm\n"
        "\xF0\x9F\x93\xB8 Photos on SD: " + String(photoCount) + "\n"
        "\xF0\x9F\x8E\xAC Videos on SD: " + String(videoCount) + "\n"
        "\xF0\x9F\x94\x95 Motion Detection: OFF (send /arm to enable)\n"
        "\xF0\x9F\x8E\xA5 Stream: VGA @10fps\n\n"
        "Send /help for all commands."
      );
      Serial.println("[TG] Bot ready");
      xTaskCreatePinnedToCore(
        telegramTask, "tgTask",
        16384, nullptr, 1, nullptr, 0);
      Serial.println("[RTOS] Telegram task started on Core 0");
    } else {
      Serial.println("[TG] No credentials - Telegram disabled");
      // Still start task so queue drains cleanly if credentials added later
      xTaskCreatePinnedToCore(
        telegramTask, "tgTask",
        16384, nullptr, 1, nullptr, 0);
    }
  } else {
    // No WiFi - start AP mode
    apMode = true;
    WiFi.mode(WIFI_AP);
    WiFi.softAP(AP_SSID, AP_PASS);
    delay(500);
    Serial.println("[WiFi] AP mode started");
    Serial.println("[WiFi] SSID: " AP_SSID "  Pass: " AP_PASS);
    Serial.println("[WiFi] Dashboard: http://" AP_IP_STR);
    // Start Telegram task anyway (queue must always be drained)
    xTaskCreatePinnedToCore(
      telegramTask, "tgTask",
      16384, nullptr, 1, nullptr, 0);
  }

  initWebServer();
  startStreamServer();

  Serial.println("[SYS] All systems GO");
  if (apMode) {
    Serial.println("[SYS] Mode: ACCESS POINT  SSID: " AP_SSID);
    Serial.println("[SYS] Dashboard -> http://" AP_IP_STR);
  } else {
    Serial.printf("[SYS] Mode: STA  IP: %s\n", WiFi.localIP().toString().c_str());
    Serial.printf("[SYS] Dashboard -> http://%s\n", WiFi.localIP().toString().c_str());
  }
  Serial.printf("[MD]  Threshold=%.2f  Cooldown=%ds  Warmup=%d frames\n",
    mdThreshold, motionCooldownS, MD_WARMUP_FRAMES);
}

// ============================================================
//  MAIN LOOP
// ============================================================
void loop(){
  webServer.handleClient();
  executePendingJob();  // run any queued photo/record job

  // WiFi reconnection watchdog (STA mode only)
  // If the router reboots or signal drops, attempt reconnect every 30 seconds.
  if (!apMode && WiFi.status() != WL_CONNECTED) {
    static unsigned long lastReconnectMs = 0;
    unsigned long now = millis();
    if (now - lastReconnectMs >= 30000) {
      lastReconnectMs = now;
      Serial.println("[WiFi] Connection lost - attempting reconnect...");
      WiFi.disconnect();
      WiFi.begin(cfgWifiSSID.c_str(), cfgWifiPass.c_str());
      // Wait up to 10 s for reconnect without blocking motion/web entirely
      for (int i = 0; i < 20 && WiFi.status() != WL_CONNECTED; i++) {
        delay(500);
        webServer.handleClient();
      }
      if (WiFi.status() == WL_CONNECTED) {
        Serial.println("[WiFi] Reconnected  IP: " + WiFi.localIP().toString());
        // Re-sync NTP after reconnect
        configTime(0, 0, NTP_SERVER);
        setenv("TZ", POSIX_TZ, 1);
        tzset();
        tgSend("WiFi reconnected. IP: " + WiFi.localIP().toString());
      } else {
        Serial.println("[WiFi] Reconnect failed - will retry in 30s");
      }
    }
  }

  // Motion detection block
  // Skipped entirely when: disarmed, recording, or within cooldown window
  if(motionArmed && !aviRecording){
    unsigned long now=millis();
    unsigned long coolMs=(unsigned long)(motionCooldownS*1000);

    if(now - lastMotionMs > coolMs){
      camera_fb_t* fb=esp_camera_fb_get();
      if(fb){
        bool motion=checkMotion(fb);
        esp_camera_fb_return(fb);

        if(motion){
          lastMotionMs=now;
          Serial.println("🏃 *** CONFIRMED ***");

          // Brief flash to illuminate scene
          ledcWrite(FLASH_LED_PIN, 255); delay(80); ledcWrite(FLASH_LED_PIN, ledDuty);

          // captureAndSavePhoto sends the photo WITH the caption - no second message needed
          captureAndSavePhoto(true,"Motion Detection",false);
        }
      }
    }
  }

  // Timelapse block
  // Skipped when: inactive, recording, or a job is already pending.
  // Uses captureAndSavePhoto() silently (no Telegram, no flash) so it
  // never interferes with motion alerts or manual captures.
  if (timelapseActive && !aviRecording && pendingJob.type == JOB_NONE) {
    unsigned long now = millis();
    unsigned long tlMs = (unsigned long)(timelapseIntervalS * 1000UL);
    if (now - lastTimelapseMs >= tlMs) {
      lastTimelapseMs = now;
      Serial.printf("[TL] Capturing timelapse frame #%d\n", photoCount + 1);
      captureAndSavePhoto(false, "Timelapse", false);
    }
  }

  // OPT: Dynamic end-of-loop yield.
  // - Skip the delay entirely when a job is queued (execute it immediately next iteration).
  // - Use vTaskDelay() instead of delay() so FreeRTOS can schedule other tasks
  //   (telegramTask, IDLE0 watchdog) during the yield rather than busy-waiting.
  // - When motion is armed and inside the cooldown window, yield only 10ms so
  //   we can process webServer clients quickly without wasting time on a fixed 30ms stall.
  if (pendingJob.type != JOB_NONE) {
    // Work is waiting - don't delay at all, fall through to next loop() immediately
  } else if (motionArmed && !aviRecording) {
    vTaskDelay(pdMS_TO_TICKS(10));  // armed: stay responsive, ~100Hz check rate
  } else {
    vTaskDelay(pdMS_TO_TICKS(30));  // idle: ~33Hz, yields to WiFi + TG task
  }
}

/*
 * ===============================================================
 *  QUICK SETUP GUIDE  v1.0
 * ===============================================================
 *
 *  1. LIBRARIES  (Sketch > Include Library > Manage Libraries)
 *       "Universal Arduino Telegram Bot"  by Brian Lough
 *       "ArduinoJson"  v6.x  by Benoit Blanchon
 *
 *  2. BOARD MANAGER URL:
 *       https://raw.githubusercontent.com/espressif/arduino-esp32/
 *       gh-pages/package_esp32_index.json
 *       Board            : AI Thinker ESP32-CAM (HW-381 + OV2640)
 *       Partition Scheme : Huge APP (3MB No OTA / 1MB SPIFFS)
 *       CPU Frequency    : 240 MHz
 *
 *  3. FILL IN at top of file:
 *       WIFI_SSID / WIFI_PASS
 *       BOT_TOKEN  (@BotFather on Telegram ? /newbot)
 *       CHAT_ID    (@userinfobot on Telegram)
 *
 *  4. KEY ARCHITECTURE NOTES (v1.0):
 *       + WebServer retained - no library compatibility issues.
 *       + Telegram FreeRTOS task pinned Core 0. tgSend() non-blocking.
 *       + sdMutex guards all SD_MMC calls across both cores.
 *       + Pending-job state machine: apiPhoto/apiRecord return
 *         instantly; executePendingJob() runs the work in loop().
 *         webServer.handleClient() is called during recording so
 *         the dashboard stays responsive even during a 30s video.
 *       + Dashboard gzip: 31 KB -> 8.5 KB PROGMEM (73% smaller).
 *       + Resolution changes always use full camera deinit+reinit.
 *       + CAMERA_GRAB_LATEST with 2 PSRAM buffers prevents overflow.
 *       + AVI dimensions auto-detected from first-frame JPEG SOF.
 *
 *  5. TUNING MOTION SENSITIVITY:
 *       Open Serial Monitor (115200 baud) and watch "[MD] MAD=x.xx"
 *       Idle scene: MAD should be 0.5-3.0
 *       Motion in frame: MAD spikes to 10+
 *       Set MD_THRESHOLD_DEFAULT just above your idle noise value
 *
 *  6. MOTION IS OFF BY DEFAULT
 *       Enable via dashboard "Enable Motion" or /arm in Telegram
 *
 *  7. FILENAMES  (on SD card):
 *       Photos : /photos/YYYY-MM-DD_HH-MM-SS.jpg
 *       Videos : /videos/YYYY-MM-DD_HH-MM-SS_<RES>_<DUR>s.avi
 *       If NTP not synced: notime_<millis>.jpg / .avi
 * ===============================================================
 */
